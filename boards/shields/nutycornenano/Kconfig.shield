## boards/shields/nutycornenano/Kconfig.shield
```kconfig
# No whitespace after the comma or in your part name!
config SHIELD_NUTYCORNENANO_LEFT
    def_bool $(shields_list_contains,nutycornenano_left)
# No whitespace after the comma or in your part name!
config SHIELD_NUTYCORNENANO_RIGHT
    def_bool $(shields_list_contains,nutycornenano_right)

# No whitespace after the comma or in the keyboard name!
config SHIELD_NUTYCORNENANO_DONGLE
    def_bool $(shields_list_contains,nutycornenano_dongle)
```

## config/west.yml
```yaml
manifest:
  defaults:
    revision: v0.3
  remotes:
    - name: zmkfirmware
      url-base: https://github.com/zmkfirmware
    # Additional modules containing boards/shields/custom code can be listed here as well
    # See https://docs.zephyrproject.org/3.2.0/develop/west/manifest.html#projects
    - name: caksoylar  # 
      url-base: https://github.com/caksoylar  # See https://docs.zephyrproject.org/3.2.0/develop/west/manifest.html#projects
  projects:
    - name: zmk
      remote: zmkfirmware
      revision: v0.3
      import: app/west.yml
    - name: zmk-rgbled-widget  # <-- new entry
      remote: caksoylar
  self:
    path: config
```
